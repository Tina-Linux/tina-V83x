## package/busybox-init-base-files/Config.in
```kconfig
# Copyright (C) 2018 Allwinner Technology Co., Ltd.
#
# This is free software, licensed under the GNU General Public License v2.
# See /LICENSE for more information.
#
if PACKAGE_busybox-init-base-files

config BUSYBOX_INIT_BASE_FILES_OPTIONS
	bool "Customize busybox init base files options"
	default n
	help
	   These options are used to customize busybox-init-base-files

config BUSYBOX_INIT_BASE_FILES_PATH
	string
	prompt "PATH for busybox base files" if BUSYBOX_INIT_BASE_FILES_OPTIONS
	default "busybox-init-base-files"
	help
	   PATH for busybox init base files


config BUSYBOX_INIT_BASE_FILES_RC_LOG
	bool "Use the rc.log"
	default n
	help
	Optimiaztions to use TOPDIR/packge/busybox-init-files/files/etc/init.d/rc.log file,which is logging junk.

	you can also customize a rc.log file under path:
		TOPDIR/target/allwinner/xxx_platform/busybox-init-files/etc/init.d.

config BUSYBOX_INIT_BASE_FILES_RC_LOAD_SCRIPT
	bool "Auto load the script in /etc/rc.d"
	default n
	help
		Optimiaztions to load the script in /etc/rc.d.

config BUSYBOX_INIT_BASE_FILES_RC_MODULES
	bool "Use the rc.modules"
	default n
	help
	Optimiaztions to use TOPDIR/packge/busybox-init-files/files/etc/init.d/rc.modules,which Automatically load the kernel module.

	you can also customize a rc.user file under path:
		TOPDIR/target/allwinner/xxx_platform/busybox-init-files/etc/rc.modules.

endif
```

## package/cortana/cortana-sdk/Config.in
```kconfig
menu "Cortana Devices SDK Configurations"
    depends on PACKAGE_cortana-sdk

comment "----------"

config CORTANA_SDK_ENABLE_CDP
    bool "Enable CDP"
    default n

config CORTANA_SDK_ENABLE_COMPANION
    bool "Enable Companion"
    default y

config CORTANA_SDK_ENABLE_SKYPE
    bool "Enable Skype"
    default n

config CORTANA_SDK_ENABLE_HARNESS
    bool "Enable Harness"
    default n

config CORTANA_SDK_ENABLE_KEYWORD_SPOTTER
    bool "Enable keyword spotter"
    default y

config CORTANA_SDK_ENABLE_LOGGING
    bool "Enable logging"
    help
      Disabling logging everywhere is useful in reducing image size.
    default y

config CORTANA_SDK_USE_USBEXT
    bool "Use USB extensions"
    help
      Uses USB extensions in the reference application for some supported USB devices.
    default n

config CORTANA_SDK_EXTERNAL_MUSIC_MANAGER
    bool "External music manager"
    help
      Disables internal music manager. You must provide your own music manager
      implementation that will handle stop, pause, etc. commands
    default n

comment "----------"

config CORTANA_SDK_BUILD_BASIC_FIRST_SAMPLE
    bool "Build cortana-basic-first-sample"
    default y

config CORTANA_SDK_BUILD_IOT_CORTANA_SDK_SAMPLE
    select CORTANA_SDK_ENABLE_HARNESS
    bool "Build iot-cortana-sdk-sample"
    default n

config CORTANA_SDK_BUILD_TESTS
    select CORTANA_SDK_ENABLE_LOGGING
    bool "Build tests"
    help
      Build tests in the cortana-core directory
    default n

comment "----------"

config CORTANA_SDK_SOUND_VOICE_PATH
    string "Sound voice path"
    help
      Specifies the target directory where voice audio files are located.
    default "/root/cortana_res/sound_voice"

config CORTANA_SDK_SOUND_PATH
    string "Sound path"
    help
      Specifies the target directory where system audio files are located.
    default "/root/cortana_res/sound"

config CORTANA_SDK_DATA_PATH
    string "Data path"
    help
      Specifies the target directory where data files are located
      (i.e. heycortana model).
    default "/root/cortana_res/data"

config CORTANA_SDK_DUMP_PATH
    string "Write Dump path"
    help
      Directory where crash dumps will be written.
    default "/tmp"

comment "----------"

config CORTANA_SDK_POST_DUMP_SNAP_LOGS_COMMAND
    string "Post dump snap logs command"
    help
      Command to execute after a crash dump is gathered.
      This is intended to gather logs.
    default ""

config CORTANA_SDK_ARIA_TENANT_TOKEN
    string "Aria tenant token"
    help
      Enable Aria and upload using the provided tenant token.
    default ""

comment "----------"

config CORTANA_SDK_CMAKE_VERBOSE_MAKEFILE
    bool "CMAKE_VERBOSE_MAKEFILE"
    help
      Enable verbose output from Makefile builds.
    default y

choice
    prompt "CMAKE_BUILD_TYPE"
    default CORTANA_SDK_CMAKE_BUILD_TYPE_NONE
    help
      Specifies the build type on single-configuration generators.

    config CORTANA_SDK_CMAKE_BUILD_TYPE_NONE
        bool "None"

    config CORTANA_SDK_CMAKE_BUILD_TYPE_DEBUG
        bool "Debug"

    config CORTANA_SDK_CMAKE_BUILD_TYPE_RELEASE
        bool "Release"

    config CORTANA_SDK_CMAKE_BUILD_TYPE_RELWITHDEBINFO
        bool "RelWithDebInfo"

    config CORTANA_SDK_CMAKE_BUILD_TYPE_MINSIZEREL
        bool "MinSizeRel"
endchoice

endmenu
```

## package/libs/alsa-lib/Config.in
```kconfig
# alsa package config

menu "Configuration"
	depends on PACKAGE_alsa-lib

config ALSA_LIB_EXTRA_resmgr
	bool "Compile to support resmgr"
	default n
	help
	  resmgr -

config ALSA_LIB_EXTRA_aload
	bool "Support reading /dev/aload*"
	default y
	help
	  aload -

config ALSA_LIB_EXTRA_mixer
	bool "Enable the mixer component"
	default y
	help
	  mixer -

config ALSA_LIB_EXTRA_pcm
	bool "Enable the pcm component"
	default y
	help
	  pcm -

config ALSA_LIB_EXTRA_rawmidi
	bool "Enable the raw MIDI component"
	default y
	help
	 rawmidi -

config ALSA_LIB_EXTRA_hwdep
	bool "Enable the hwdep component"
	default y
	help
	  hwdep -

config ALSA_LIB_EXTRA_seq
	bool "Enable the sequencer component"
	default y
	help
	  seq -

config ALSA_LIB_EXTRA_ucm
	bool "Support use-case-manager component"
	default y
	help

config ALSA_LIB_EXTRA_topology
	bool "Enable the DSP topology component"
	default y
	help
	  topology -

config ALSA_LIB_EXTRA_alisp
	bool "Enable the alisp component"
	default y
	help
	  alisp -

endmenu
```
