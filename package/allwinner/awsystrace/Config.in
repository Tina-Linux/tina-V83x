## package/allwinner/swupdate/config/Config.in
```kconfig
#
# For a description of the syntax of this configuration file,
# see scripts/kbuild/config-language.txt.
#


config SWUPDATE_CONFIG_HAVE_LINUX
	bool
	default y
	#option env="HAVE_LINUX"

config SWUPDATE_CONFIG_HAVE_FREEBSD
	bool
	default n
	#option env="HAVE_FREEBSD"

config SWUPDATE_CONFIG_HAVE_DOT_CONFIG
	bool
	default SWUPDATE_DEFAULT_HAVE_DOT_CONFIG

config SWUPDATE_CONFIG_HAVE_LUA
	bool
	default y
	#option env="HAVE_LUA"

config SWUPDATE_CONFIG_HAVE_LIBCONFIG
	bool
	default y
	#option env="HAVE_LIBCONFIG"

config SWUPDATE_CONFIG_HAVE_LIBARCHIVE
	bool
	default y
	#option env="HAVE_LIBARCHIVE"

config SWUPDATE_CONFIG_HAVE_LIBCURL
	bool
	default y
	#option env="HAVE_LIBCURL"

config SWUPDATE_CONFIG_HAVE_LIBGPIOD
	bool
	default y
	#option env="HAVE_LIBGPIOD"

config SWUPDATE_CONFIG_HAVE_LIBMTD
	bool
	default y
	#option env="HAVE_LIBMTD"

config SWUPDATE_CONFIG_HAVE_LIBUBI
	bool
	default y
	#option env="HAVE_LIBUBI"

config SWUPDATE_CONFIG_HAVE_LIBUBOOTENV
	bool
	default y
	#option env="HAVE_LIBUBOOTENV"

config SWUPDATE_CONFIG_HAVE_LIBEBGENV
	bool
	default y
	#option env="HAVE_LIBEBGENV"

config SWUPDATE_CONFIG_HAVE_LIBZEROMQ
	bool
	default y
	#option env="HAVE_LIBZEROMQ"

config SWUPDATE_CONFIG_HAVE_ZLIB
	bool
	default y
	#option env="HAVE_ZLIB"

config SWUPDATE_CONFIG_HAVE_LIBSSL
	bool
	default y
	#option env="HAVE_LIBSSL"

config SWUPDATE_CONFIG_HAVE_LIBCRYPTO
	bool
	default y
	#option env="HAVE_LIBCRYPTO"

config SWUPDATE_CONFIG_HAVE_JSON_C
	bool
	default y
	#option env="HAVE_JSON_C"

menu "Swupdate Settings"

menu "General Configuration"

config SWUPDATE_CONFIG_CURL
	bool
	default SWUPDATE_DEFAULT_CURL

config SWUPDATE_CONFIG_CURL_SSL
	bool
	default SWUPDATE_DEFAULT_CURL_SSL

config SWUPDATE_CONFIG_SYSTEMD
	bool "enable systemd support"
	depends on SWUPDATE_CONFIG_HAVE_LINUX
	default SWUPDATE_DEFAULT_SYSTEMD
	help
	  Enable support for systemd's start-up completion
	  notification and socket-based activation features.

config SWUPDATE_CONFIG_SCRIPTS
	bool "enable pre and postinstall scripts"
	default SWUPDATE_DEFAULT_SCRIPTS
	help
	  Enabling this option, the installer will run
	  pre- and postinstall scripts, if they are present
	  in the image. For security reason, this option
	  can be switched off.

config SWUPDATE_CONFIG_HW_COMPATIBILITY
	bool "check for hardware / software compatibility"
	default SWUPDATE_DEFAULT_HW_COMPATIBILITY
	help
	  If enabled, check if the hardware revision
	  supports the software version. Detecting the hardware
	  revision is very board specific, and it cannot be generalized.
	  For this reason, the software expects that the detected
	  version is written into a file by a previous software.

config SWUPDATE_CONFIG_HW_COMPATIBILITY_FILE
	string "File with detected hardware revisions"
	depends on SWUPDATE_CONFIG_HW_COMPATIBILITY
	default SWUPDATE_DEFAULT_HW_COMPATIBILITY_FILE
	help
	  File where to read the detected hardware revsion
	  that must be compared with the software version.
	  The file has simple entries (one per line) in the
	  format of "major.minor".

config SWUPDATE_CONFIG_SW_VERSIONS_FILE
	string "File with detected software version"
	default SWUPDATE_DEFAULT_SW_VERSIONS_FILE
	help
	  This is an optional file that is scanned at the
	  beginning to read the installed versions of
	  all sw-components. Each entry in the file is a
	  a pair of "name version".
	  In sw-description,  an image can have the
	  optional attributes:
		"name" : key for searching in SW_VERSIONS_FILE
		"version" : version contained in the .swu
		"install-if-different" : if set, version
	  		is compared with the one in SW_VERSIONS_FILE.
	  The image is installed only if there is a version mismatch.
	  This lets reduce risks in case of components that are not
	  safe to be updated, such as the bootloader. Updating it is a risk,
	  but in some cases it can be required to do it. Having a check,
	  the risky-component is not always updated.

menu "Socket Paths"

config SWUPDATE_CONFIG_SOCKET_CTRL_PATH
	string "SWUpdate control socket path"
	default SWUPDATE_DEFAULT_SOCKET_CTRL_PATH
	help
	  Path to SWUpdate's IPC socket.

config SWUPDATE_CONFIG_SOCKET_PROGRESS_PATH
	string "SWUpdate progress socket path"
	default SWUPDATE_DEFAULT_SOCKET_PROGRESS_PATH
	help
	  Path to the socket progress information is sent to.

config SWUPDATE_CONFIG_SOCKET_REMOTE_HANDLER_DIRECTORY
	string "SWUpdate remote handler socket directory"
	default SWUPDATE_DEFAULT_SOCKET_REMOTE_HANDLER_DIRECTORY
	help
	  Directory where sockets to remote handler processes
	  are expected to be found.

config SWUPDATE_CONFIG_SOCKET_NOTIFIER_DIRECTORY
	string "SWUpdate notifier socket directory"
	depends on SWUPDATE_CONFIG_HAVE_FREEBSD
	default SWUPDATE_DEFAULT_SOCKET_NOTIFIER_DIRECTORY
	help
	  Path to SWUpdate's Notifier sockets on FreeBSD as
	  Linux-like abstract sockets are not available.

endmenu

config SWUPDATE_CONFIG_MTD
	bool "MTD support"
	default SWUPDATE_DEFAULT_MTD
	depends on SWUPDATE_CONFIG_HAVE_LIBMTD
	help
	  Enable MTD support.

comment "MTD support needs libmtd"
	depends on !SWUPDATE_CONFIG_HAVE_LIBMTD && SWUPDATE_CONFIG_HAVE_LINUX

config SWUPDATE_CONFIG_LUA
	bool "lua"
	default SWUPDATE_DEFAULT_LUA
	depends on SWUPDATE_CONFIG_HAVE_LUA
	help
	  Enable Lua interpreter.

comment "Lua support needs a Lua interpreter"
	depends on !SWUPDATE_CONFIG_HAVE_LUA

config SWUPDATE_CONFIG_LUAPKG
	string "Lua pkg-config name"
	default SWUPDATE_DEFAULT_LUAPKG
	depends on SWUPDATE_CONFIG_LUA
	help
	  Which pkg-config package supplies the Lua API.

# These are auto-selected by other options

config SWUPDATE_CONFIG_FEATURE_SYSLOG
	bool #No description makes it a hidden option
	default SWUPDATE_DEFAULT_FEATURE_SYSLOG
	#help
	#  This option is auto-selected when you select any applet which may
	#  send its output to syslog. You do not need to select it manually.

endmenu

menu 'Build Options'

config SWUPDATE_CONFIG_CROSS_COMPILE
	string "Cross Compiler prefix"
	default SWUPDATE_DEFAULT_CROSS_COMPILE
	help
	  If you want to build swupdate with a cross compiler, then you
	  will need to set this to the cross-compiler prefix, for example,
	  "i386-uclibc-".

	  Native builds leave this empty.

config SWUPDATE_CONFIG_SYSROOT
	string "Path to sysroot"
	default SWUPDATE_DEFAULT_SYSROOT
	help
	  If you want to build swupdate with a cross compiler, then you
	  might also need to specify where /usr/include and /usr/lib
	  will be found.

	  For example, swupdate can be built against an installed
	  Android NDK, platform version 9, for ARM ABI with

	  CONFIG_SYSROOT=/opt/android-ndk/platforms/android-9/arch-arm

	  Native builds leave this empty.

config SWUPDATE_CONFIG_EXTRA_CFLAGS
	string "Additional CFLAGS"
	default SWUPDATE_DEFAULT_EXTRA_CFLAGS
	help
	  Additional CFLAGS to pass to the compiler verbatim.

config SWUPDATE_CONFIG_EXTRA_LDFLAGS
	string "Additional LDFLAGS"
	default SWUPDATE_DEFAULT_EXTRA_LDFLAGS
	help
	  Additional LDFLAGS to pass to the linker verbatim.

config SWUPDATE_CONFIG_EXTRA_LDLIBS
	string "Additional LDLIBS"
	default SWUPDATE_DEFAULT_EXTRA_LDLIBS
	help
	  Additional LDLIBS to pass to the linker with -l.

endmenu

menu 'Debugging Options'

config SWUPDATE_CONFIG_DEBUG
	bool "Build Swupdate with extra Debugging symbols"
	default SWUPDATE_DEFAULT_DEBUG
	help
	  Say Y here if you wish to examine swupdate internals while applets are
	  running. This increases the size of the binary considerably, and
	  should only be used when doing development. If you are doing
	  development and want to debug swupdate, answer Y.

	  Most people should answer N.

config SWUPDATE_CONFIG_DEBUG_PESSIMIZE
	bool "Disable compiler optimizations"
	default SWUPDATE_DEFAULT_DEBUG_PESSIMIZE
	depends on SWUPDATE_CONFIG_DEBUG
	help
	  The compiler's optimization of source code can eliminate and reorder
	  code, resulting in an executable that's hard to understand when
	  stepping through it with a debugger. This switches it off, resulting
	  in a much bigger executable that more closely matches the source
	  code.

config SWUPDATE_CONFIG_WERROR
	bool "Abort compilation on any warning"
	default SWUPDATE_DEFAULT_WERROR
	help
	  Selecting this will add -Werror to gcc command line.

	  Most people should answer N.

config SWUPDATE_CONFIG_NOCLEANUP
	bool "Do not remove temporary files after execution"
	default SWUPDATE_DEFAULT_NOCLEANUP
	help
	  After each run, temporary files are removed from the directory
	  pointed to by the environment variable TMPDIR (/tmp as fallback
	  if unset) to restart in a clean state. For debugging purposes, it
	  helps to check the consistency of the files extracted by SWUpdate.
	  For production, answer N.

endmenu

endmenu

source bootloader/Config.in


config SWUPDATE_CONFIG_DOWNLOAD
	bool "Enable image downloading"
	default SWUPDATE_DEFAULT_DOWNLOAD
	depends on SWUPDATE_CONFIG_HAVE_LIBCURL
	select SWUPDATE_CONFIG_CHANNEL_CURL
	help
	  Enable update from image URL using libcurl. The stream is sent via IPC
	  to the installer as it is done for other interfaces.

comment "Image downloading support needs libcurl"
	depends on !SWUPDATE_CONFIG_HAVE_LIBCURL

config SWUPDATE_CONFIG_DOWNLOAD_SSL
	bool "Enable SSL support for image downloading"
	default SWUPDATE_DEFAULT_DOWNLOAD_SSL
	depends on SWUPDATE_CONFIG_DOWNLOAD
	depends on SWUPDATE_CONFIG_HAVE_LIBSSL
	depends on SWUPDATE_CONFIG_HAVE_LIBCRYPTO
	select SWUPDATE_CONFIG_CHANNEL_CURL_SSL
	help
	  Enable SSL and checksum verification support in channels
	  using libcurl.

config SWUPDATE_CONFIG_CHANNEL_CURL
	bool
	depends on SWUPDATE_CONFIG_HAVE_LIBCURL
	select SWUPDATE_CONFIG_CURL

config SWUPDATE_CONFIG_CHANNEL_CURL_SSL
	bool
	depends on SWUPDATE_CONFIG_CHANNEL_CURL
	depends on SWUPDATE_CONFIG_HAVE_LIBSSL
	depends on SWUPDATE_CONFIG_HAVE_LIBCRYPTO
	select SWUPDATE_CONFIG_CURL_SSL

config SWUPDATE_CONFIG_HASH_VERIFY
	bool "Allow to add sha256 hash to each image"
	depends on SWUPDATE_CONFIG_HAVE_LIBSSL
	help
	  Allow to add a sha256 hash to an artifact.
	  This is automatically set in case of Signed Image

comment "Hash verification needs libssl"
	depends on !SWUPDATE_CONFIG_HAVE_LIBSSL

config SWUPDATE_CONFIG_SIGNED_IMAGES
	bool "Enable verification of signed images"
	depends on SWUPDATE_CONFIG_HAVE_LIBSSL
	select SWUPDATE_CONFIG_HASH_VERIFY
comment "Image verification (signed images) needs libssl"
	depends on !SWUPDATE_CONFIG_HAVE_LIBSSL

choice
	prompt "Signature verification algorithm"
	depends on SWUPDATE_CONFIG_SIGNED_IMAGES
	default SWUPDATE_CONFIG_SIGALG_RAWRSA
	help
	  Select if the signature algorithm for signed images is a raw RSA signature
	  (following PKCS#1.5) or if it uses Cryptographic Message Syntax (CMS).

	config SWUPDATE_CONFIG_SIGALG_RAWRSA
		bool "RSA PKCS#1.5"

	config SWUPDATE_CONFIG_SIGALG_CMS
		bool "Cryptographic Message Syntax (CMS)"

endchoice

menu "CMS signature verification options"
	depends on SWUPDATE_CONFIG_SIGALG_CMS

config SWUPDATE_CONFIG_CMS_IGNORE_EXPIRED_CERTIFICATE
	bool "Ignore expired certificates"
	depends on SWUPDATE_CONFIG_SIGALG_CMS

config SWUPDATE_CONFIG_CMS_IGNORE_CERTIFICATE_PURPOSE
	bool "Ignore X.509 certificate purpose"
	depends on SWUPDATE_CONFIG_SIGALG_CMS
endmenu


config SWUPDATE_CONFIG_ENCRYPTED_IMAGES
	bool "Images can be encrypted with a symmetric key"
	depends on SWUPDATE_CONFIG_HAVE_LIBSSL
comment "Image encryption needs libssl"
	depends on !SWUPDATE_CONFIG_HAVE_LIBSSL

source suricatta/Config.in

source mongoose/Config.in

config SWUPDATE_CONFIG_GUNZIP
	bool
	depends on SWUPDATE_CONFIG_HAVE_ZLIB
	default SWUPDATE_DEFAULT_GUNZIP

source parser/Config.in
source handlers/Config.in
source reduce/Config.in
```

## package/allwinner/swupdate/config/bootloader/Config.in
```kconfig
choice
	prompt "Bootloader (U-Boot, ..)"
	default SWUPDATE_CONFIG_UBOOT
	help
	  Choose the bootloader

config SWUPDATE_CONFIG_BOOTLOADER_EBG
	bool "EFI Boot Guard"
	depends on SWUPDATE_CONFIG_HAVE_LIBEBGENV
	depends on SWUPDATE_CONFIG_HAVE_ZLIB
	help
	  Support for EFI Boot Guard
	  https://github.com/siemens/efibootguard

comment "EFI Boot Guard needs libebgenv and libz"
	depends on !SWUPDATE_CONFIG_HAVE_ZLIB || !SWUPDATE_CONFIG_HAVE_LIBEBGENV

config SWUPDATE_CONFIG_UBOOT
	bool "U-Boot"
	depends on SWUPDATE_CONFIG_HAVE_LIBUBOOTENV
	depends on SWUPDATE_CONFIG_HAVE_ZLIB
	help
	  Support for U-Boot
	  https://www.denx.de/wiki/U-Boot

config SWUPDATE_CONFIG_BOOTLOADER_NONE
	bool "Environment in RAM"
	help
	  This simulates the interface to a bootloader.
	  Bootloader environment is just maitained in RAM
	  and lost when SWUpdate exits.

config SWUPDATE_CONFIG_BOOTLOADER_GRUB
	bool "GRUB"
	help
	  Support for GRUB
	  https://www.gnu.org/software/grub/
endchoice

config SWUPDATE_CONFIG_UBOOT_FWENV
	string "U-Boot Environment Configuration file"
	depends on SWUPDATE_CONFIG_UBOOT
	default SWUPDATE_DEFAULT_UBOOT_FWENV
	help
	  This is the file described in U-Boot documentation
	  in the tools directory. It tells where the U-Boot
	  environment is saved.

config SWUPDATE_CONFIG_UBOOT_NEWAPI
	bool "Link to new libubootenv API (LGPL-2.1)"
	depends on SWUPDATE_CONFIG_UBOOT
	help
	  Use a replacement of tools/env from U-Boot
	  This is to link to libubootenv

comment "U-Boot support needs libubootenv, libz"
	depends on !SWUPDATE_CONFIG_HAVE_LIBUBOOTENV || !SWUPDATE_CONFIG_HAVE_ZLIB

config SWUPDATE_CONFIG_UBOOT_DEFAULTENV
	string "U-Boot Initial Environment file"
	depends on SWUPDATE_CONFIG_UBOOT_NEWAPI
	default SWUPDATE_DEFAULT_UBOOT_DEFAULTENV
	help
	  This is the file with the initial environment delivered
	  with the bootloader. It is used by SWUpdate if no environment
	  is found on the storage.

config SWUPDATE_CONFIG_GRUBENV_PATH
	string "GRUB Environment block file path"
	depends on SWUPDATE_CONFIG_BOOTLOADER_GRUB
	default SWUPDATE_DEFAULT_GRUBENV_PATH
	help
	  Provide path to GRUB environment block file
```
