## package/testtools/tinatest/config/base/storage/Config.in
```kconfig
menuconfig TINATEST_BASE_STORAGE
    bool "storage"

if TINATEST_BASE_STORAGE
    source hotplug/Config.in
    source rwdev/Config.in
endif
```

## package/testtools/tinatest/config/base/wifi/Config.in
```kconfig
menuconfig TINATEST_BASE_WIFI
    bool "wifi"

if TINATEST_BASE_WIFI
    source wifi_connect/Config.in
    source wifi_scan/Config.in
    source wifi_remove_network/Config.in
    source wifi_remove_all_network/Config.in
endif
```

## package/testtools/tinatest/config/demo/Config.in
```kconfig
menuconfig TINATEST_DEMO
    bool "demo"

if TINATEST_DEMO
    source demo-sh/Config.in
    source demo-c/Config.in
endif
```

## package/testtools/tinatest/config/spec/Config.in
```kconfig
menuconfig TINATEST_SPEC
    bool 'spec'

if TINATEST_SPEC
    source benchmarks/Config.in
    source storage/Config.in
endif
```

## package/testtools/tinatest/config/spec/benchmarks/Config.in
```kconfig
menuconfig TINATEST_SPEC_BENCHMARKS
    bool "benchmarks"

if TINATEST_SPEC_BENCHMARKS
    source coremark/Config.in
    source linpack/Config.in
endif
```

## package/testtools/tinatest/config/spec/storage/Config.in
```kconfig
menuconfig TINATEST_SPEC_STORAGE
    bool "storage"

if TINATEST_SPEC_STORAGE
    source rand/Config.in
    source seq/Config.in
    source tiny-seq/Config.in
endif
```

## package/testtools/tinatest/config/stress/Config.in
```kconfig
menuconfig TINATEST_STRESS
    bool "stress"

if TINATEST_STRESS
    source reboot/Config.in
    source gpu/Config.in
    source ddr/Config.in
    source cpu/Config.in
    source storage/Config.in
    source wifi/Config.in
    source standby/Config.in
endif
```

## package/testtools/tinatest/config/stress/cpu/Config.in
```kconfig
menuconfig TINATEST_STRESS_CPU
    bool "cpu"

if TINATEST_STRESS_CPU
    source cpucalc/Config.in
    source cpufreq/Config.in
    source cpuhotplug/Config.in
endif
```

## package/testtools/tinatest/config/stress/reboot/Config.in
```kconfig
menuconfig TINATEST_STRESS_REBOOT_ENABLE
    bool "reboot"
    default n
    ---help---
        Settings for /stress/reboot
        It safe to leave a blank for any settings.
        If not setted, TinaTest will use global settings or default settings instead.

if TINATEST_STRESS_REBOOT_ENABLE
    config TINATEST_STRESS_REBOOT_COMMAND
        default "echo \"===== Going to reboot =====\"; reboot -f; exit 1"
    config TINATEST_STRESS_REBOOT_STDIN
        default ""
    config TINATEST_STRESS_REBOOT_FSTDIN
        default ""
    config TINATEST_STRESS_REBOOT_DATE
        default n
    config TINATEST_STRESS_REBOOT_RESOURCE
        default n
    config TINATEST_STRESS_REBOOT_REAL_TIME_LOG
        default y
    config TINATEST_STRESS_REBOOT_RUN_TIMES
        default 1000
    config TINATEST_STRESS_REBOOT_RUN_ALONE
        default y
    config TINATEST_STRESS_REBOOT_RUN_PARALLEL
        default y if TINATEST_SYS_LOCAL_LIMIT_RUN_PARALLEN
    config TINATEST_STRESS_REBOOT_MAY_REBOOT
        default y
    config TINATEST_STRESS_REBOOT_TESTCASE_RUN_ONCE_TIME
        default ""
    config TINATEST_STRESS_REBOOT_TESTCASE_RUN_TIME
        default ""
    config TINATEST_STRESS_REBOOT_TIMEOUT_AS_FAILED
        default n
    config TINATEST_STRESS_REBOOT_EXIT_ONCE_FAILED
        default y

    comment "Advanced Customized"
    config TINATEST_STRESS_REBOOT_ADVANCED
        bool "Advanced"

    if TINATEST_STRESS_REBOOT_ADVANCED
        config TINATEST_STRESS_REBOOT_COMMAND
            string "command"
            ---help---
                TinaTest will run this command to start testcase.
                It is the same as shell command which followed by argumemts.
                This setting is a mark of any testcase.

        config TINATEST_STRESS_REBOOT_STDIN
            string "stdin"
            ---help---
                Redirect a string array, which is setted in this configure, to standard input.
                For example,
                "one two three four" is equivalent to enter 4 times to testcase every run_time.
                The first time, enter "one" with new line,
                the second time, enter "two" with new line, and so on.

        config TINATEST_STRESS_REBOOT_FSTDIN
            string "fstdin"
            ---help---
                Redirect a file, which is setted in this configure, to standard input.

        config TINATEST_STRESS_REBOOT_INFO
            bool "INFO"
            default y

        if TINATEST_STRESS_REBOOT_INFO
            config TINATEST_STRESS_REBOOT_DATE
                bool "date"
                ---help---
                    Save running date and time.

            config TINATEST_STRESS_REBOOT_RESOURCE
                bool "resource"
                ---help---
                    Save resources for each testcase.

            config TINATEST_STRESS_REBOOT_REAL_TIME_LOG
                bool "real_time_log"
                ---help---
                    Print log of testcase real time.
                    In default, tinatest just collect all log, and print them when testcase end.
        endif

        config TINATEST_STRESS_REBOOT_LIMIT
            bool "LIMIT"
            default y

        if TINATEST_STRESS_REBOOT_LIMIT
            config TINATEST_STRESS_REBOOT_RUN_TIMES
                int "run_times"
                ---help---
                    The times to run testcase.
                    For example:
                    To run this testcase for 3 times, we can set this value as 3.

            config TINATEST_STRESS_REBOOT_RUN_ALONE
                bool "run_alone"
                ---help---
                    Wait for finishing all previous testcase and run alone before do next.

            config TINATEST_STRESS_REBOOT_RUN_PARALLEL
                bool "run_parallel"
                ---help---
                    Run parallel for all run_times.
                    For example:
                    Testcae will run for 3 times one by one if run_times=3.
                    However, if run_parallel is setted, tinatest will creates 3 processers
                    in one time.

            config TINATEST_STRESS_REBOOT_MAY_REBOOT
                bool "may_reboot"
                ---help---
                    It means that device will be rebooted while running testcase.
                    All states of testcase will be saved in flash, and loaded after rebooting.
                    Notices that, if may_reboot is setted, run_alone will be setted alway.

            config TINATEST_STRESS_REBOOT_TESTCASE_RUN_ONCE_TIME
                string "testcase_run_once_time"
                ---help---
                    Time limit for testcase to run once.
                    It is in format:
                        <sec> <min> <hour> <day>
                    For example,
                    100s : 100
                    1m20s : 20 1 (or 80)
                    1d3h : 0 0 3 1 (or 0 0 28 or other)

            config TINATEST_STRESS_REBOOT_TESTCASE_RUN_TIME
                string "testcase_run_time"
                ---help---
                    Time limit for testcase to run.
                    It is in format:
                        <sec> <min> <hour> <day>
                    For example,
                    100s : 100
                    1m20s : 20 1 (or 80)
                    1d3h : 0 0 3 1 (or 0 0 28 or other)

            config TINATEST_STRESS_REBOOT_TIMEOUT_AS_FAILED
                bool "timeout_as_failed"
                ---help---
                    Seem to failed when testcase exit for timeout.
                    If not set, default as pass.

            config TINATEST_STRESS_REBOOT_EXIT_ONCE_FAILED
                bool "exit_once_failed"
                ---help---
                    Stop running testcase and exit once failed,
                    even if runned times less than run_times.
        endif
    endif
endif
```

## package/testtools/tinatest/config/stress/storage/Config.in
```kconfig
menuconfig TINATEST_STRESS_STORAGE
    bool "storage"

if TINATEST_STRESS_STORAGE
    source fulldisk/Config.in
    source power-fail/Config.in
    source throughput/Config.in
endif
```

## package/testtools/tinatest/config/sys/Config.in
```kconfig
menu 'System Config'
    source build/Config.in
    source global/Config.in
    source local/Config.in
endmenu
```

## package/testtools/tinatest/config/sys/build/Config.in
```kconfig
menu "build"
    comment "Settings For Build"
    source boot-script/Config.in
    source completion/Config.in
endmenu
```

## package/testtools/tinatest/config/sys/build/boot-script/Config.in
```kconfig
config TINATEST_SYS_BUILD_BOOT_SCRIPT
    bool "boot_script"
    select BUSYBOX_INIT_BASE_FILES_RC_LOAD_SCRIPT if SYSTEM_INIT_BUSYBOX
    default n
    help
        Install boot script.
        By this script, TinaTest can run automatically when boot.

    if TINATEST_SYS_BUILD_BOOT_SCRIPT
        config TINATEST_SYS_BUILD_BOOT_SCRIPT_COMMAND
            string "command"
            default "tt"
            help
                The command to call when boot.

        config TINATEST_SYS_BUILD_BOOT_SCRIPT_LEVEL
            int "level"
            range 0 99
            default 99
            help
                The boot level, limited in 0-99.
                The smaller value, the earlier call.
                It is used in serial mode of calling boot script.

        config TINATEST_SYS_BUILD_BOOT_SCRIPT_DEPEND
            string "depend"
            default "sysntpd"
            help
                The boot dependences.
                Call this boot script after all dependences.
                It is used in parallel mode of calling boot script.
    endif
```

## package/testtools/tinatest/config/sys/build/completion/Config.in
```kconfig
config TINATEST_SYS_BUILD_COMPLETION
    bool "completion"
    default y
    help
        Completion for ash for testcases.
        Do conplete by making direcotry and file for each testcase.
```

## package/testtools/tinatest/config/sys/global/Config.in
```kconfig
menuconfig TINATEST_SYS_GLOBAL
    bool "global"
    default y

if TINATEST_SYS_GLOBAL
    source info/Config.in
    source limit/Config.in
endif
```

## package/testtools/tinatest/config/sys/global/info/Config.in
```kconfig
config TINATEST_SYS_GLOBAL_INFO
    bool "info"
    default y

if TINATEST_SYS_GLOBAL_INFO
    source outlog/Config.in
    source collectd/Config.in
endif
```

## package/testtools/tinatest/config/sys/global/info/collectd/Config.in
```kconfig
menuconfig TINATEST_SYS_GLOBAL_INFO_COLLECTD
    bool "collectd"
    select PACKAGE_collectd
    default n

if TINATEST_SYS_GLOBAL_INFO_COLLECTD
    #===== interval sec =====
    config TINATEST_SYS_GLOBAL_INFO_COLLECTD_INTERVAL_SEC
        int "collectd_interval_sec"
        default 2

    #===== mcollectd =====
    source rrdtool/Config.in
    source csv/Config.in
    source cpu/Config.in
    source memory/Config.in
    source df/Config.in
    source disk/Config.in
    source filecount/Config.in
    source ping/Config.in
endif
```

## package/testtools/tinatest/config/sys/global/info/collectd/cpu/Config.in
```kconfig
menuconfig TINATEST_SYS_GLOBAL_INFO_COLLECTD_CPU_ENABLE
    bool "collectd_cpu"
    select PACKAGE_collectd-mod-cpu
    default n

if TINATEST_SYS_GLOBAL_INFO_COLLECTD_CPU_ENABLE
    config TINATEST_SYS_GLOBAL_INFO_COLLECTD_CPU_REPORT_TO_PERCENTAGE
        bool "report_to_percentage"
        default n
endif
```

## package/testtools/tinatest/config/sys/global/info/collectd/csv/Config.in
```kconfig
menuconfig TINATEST_SYS_GLOBAL_INFO_COLLECTD_CSV_ENABLE
    bool "collectd_csv"
    select PACKAGE_collectd-mod-csv
    default y

if TINATEST_SYS_GLOBAL_INFO_COLLECTD_CSV_ENABLE
    config TINATEST_SYS_GLOBAL_INFO_COLLECTD_CSV_OUTDIR
        string "outdir"
        default "/mnt/UDISK/collectd"
endif
```

## package/testtools/tinatest/config/sys/global/info/collectd/df/Config.in
```kconfig
menuconfig TINATEST_SYS_GLOBAL_INFO_COLLECTD_DF_ENABLE
    bool "collectd_df"
    select PACKAGE_collectd-mod-df
    default n

if TINATEST_SYS_GLOBAL_INFO_COLLECTD_DF_ENABLE
    config TINATEST_SYS_GLOBAL_INFO_COLLECTD_DF_REPORT_TO_ABSOLUTE
        bool "report_to_absolute"
        default n

    config TINATEST_SYS_GLOBAL_INFO_COLLECTD_DF_REPORT_TO_PERCENTAGE
        bool "report_to_percentage"
        default y

    config TINATEST_SYS_GLOBAL_INFO_COLLECTD_DF_MATCH
        bool "match"
        default y

    if TINATEST_SYS_GLOBAL_INFO_COLLECTD_DF_MATCH
        config TINATEST_SYS_GLOBAL_INFO_COLLECTD_DF_MATCH_SELLECT_OR_IGNORE
            string "sellect_or_ignore"
            default "sellect"

        config TINATEST_SYS_GLOBAL_INFO_COLLECTD_DF_MATCH_DEVICE
            string "device"
            default "ALL"

        config TINATEST_SYS_GLOBAL_INFO_COLLECTD_DF_MATCH_MOUNTPOINT
            string "mountpoint"
            default "ALL"

        config TINATEST_SYS_GLOBAL_INFO_COLLECTD_DF_MATCH_FSTYPE
            string "fstype"
            default "ALL"
    endif
endif
```

## package/testtools/tinatest/config/sys/global/info/collectd/disk/Config.in
```kconfig
menuconfig TINATEST_SYS_GLOBAL_INFO_COLLECTD_DISK_ENABLE
    bool "collectd_disk"
    select PACKAGE_collectd-mod-disk
    default n

if TINATEST_SYS_GLOBAL_INFO_COLLECTD_DISK_ENABLE
    config TINATEST_SYS_GLOBAL_INFO_COLLECTD_DISK_MATCH
        bool "match"
        default y

    if TINATEST_SYS_GLOBAL_INFO_COLLECTD_DISK_MATCH
        config TINATEST_SYS_GLOBAL_INFO_COLLECTD_DISK_MATCH_SELLECT_OR_IGNORE
            string "sellect_or_ignore"
            default "sellect"

        config TINATEST_SYS_GLOBAL_INFO_COLLECTD_DISK_MATCH_DISK_REGULAR_EXPRESSION
            string "disk_regular_expression"
            default "mmcblk0p.*"
    endif
endif
```

## package/testtools/tinatest/config/sys/global/info/collectd/filecount/Config.in
```kconfig
menuconfig TINATEST_SYS_GLOBAL_INFO_COLLECTD_FILECOUNT_ENABLE
    bool "collectd_filecount"
    select PACKAGE_collectd-mod-filecount
    default n

if TINATEST_SYS_GLOBAL_INFO_COLLECTD_FILECOUNT_ENABLE
    config TINATEST_SYS_GLOBAL_INFO_COLLECTD_FILECOUNT_DIRECTORY
        string "direcotry"
        default "/mnt/UDISK"

    config TINATEST_SYS_GLOBAL_INFO_COLLECTD_FILECOUNT_INCLUDE_HIDDEN
        bool "include_hidden"
        default n

    config TINATEST_SYS_GLOBAL_INFO_COLLECTD_FILECOUNT_INCLUDE_SUBDIR
        bool "include_subdir"
        default n

    config TINATEST_SYS_GLOBAL_INFO_COLLECTD_FILECOUNT_MATCH
        bool "match"
        default y

    if TINATEST_SYS_GLOBAL_INFO_COLLECTD_FILECOUNT_MATCH
        config TINATEST_SYS_GLOBAL_INFO_COLLECTD_FILECOUNT_MATCH_NAME
            string "name"
            default "ALL"

        config TINATEST_SYS_GLOBAL_INFO_COLLECTD_FILECOUNT_MATCH_SIZE
            string "size"
            default "ALL"

        config TINATEST_SYS_GLOBAL_INFO_COLLECTD_FILECOUNT_MATCH_MTIME
            string "mtime"
            default "ALL"
    endif
endif
```

## package/testtools/tinatest/config/sys/global/info/collectd/memory/Config.in
```kconfig
menuconfig TINATEST_SYS_GLOBAL_INFO_COLLECTD_MEMORY_ENABLE
    bool "collectd_memory"
    select PACKAGE_collectd-mod-memory
    default n

if TINATEST_SYS_GLOBAL_INFO_COLLECTD_MEMORY_ENABLE
    config TINATEST_SYS_GLOBAL_INFO_COLLECTD_MEMORY_REPORT_TO_ABSOLUTE
        bool "report_to_absolute"
        default n

    config TINATEST_SYS_GLOBAL_INFO_COLLECTD_MEMORY_REPORT_TO_PERCENTAGE
        bool "report_to_percentage"
        default y
endif
```
