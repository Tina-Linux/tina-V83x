## package/testtools/tinatest/config/sys/global/info/outlog/Config.in
```kconfig
menuconfig TINATEST_SYS_GLOBAL_INFO_OUTLOG
    bool "outlog"
    default y

if TINATEST_SYS_GLOBAL_INFO_OUTLOG
    source serial/Config.in
    source markdown/Config.in
    source dragonmat/Config.in
endif
```

## package/testtools/tinatest/config/sys/global/info/outlog/dragonmat/Config.in
```kconfig
menuconfig TINATEST_SYS_GLOBAL_INFO_OUTLOG_DRAGONMAT
    bool "DragonMAT"
    select TINATEST_SYS_BUILD_BOOT_SCRIPT
    default n

if TINATEST_SYS_GLOBAL_INFO_OUTLOG_DRAGONMAT
    config TINATEST_SYS_GLOBAL_INFO_OUTLOG_DRAGONMAT_WAIT_TILL_CONNECTED
        bool "wait_till_connected"
        default y

    config TINATEST_SYS_GLOBAL_INFO_OUTLOG_DRAGONMAT_EXIT_WHEN_END
        bool "exit_when_end"
        default n

    config TINATEST_SYS_GLOBAL_INFO_OUTLOG_DRAGONMAT_EXIT_CALL
        string "exit_call"
endif
```

## package/testtools/tinatest/config/sys/global/info/outlog/markdown/Config.in
```kconfig
menuconfig TINATEST_SYS_GLOBAL_INFO_OUTLOG_MARKDOWN
    bool "Markdown"
    default n

if TINATEST_SYS_GLOBAL_INFO_OUTLOG_MARKDOWN
    config TINATEST_SYS_GLOBAL_INFO_OUTLOG_MARKDOWN_OUTDIR
        string "outdir"
        default "/mnt/UDISK/md"
endif
```

## package/testtools/tinatest/config/sys/global/limit/Config.in
```kconfig
config TINATEST_SYS_GLOBAL_LIMIT
    bool "limit"
    default y

if TINATEST_SYS_GLOBAL_LIMIT
    config TINATEST_SYS_GLOBAL_LIMIT_RUN_CNT_UP_TO
        int "run_cnt_up_to"
        range 1 100
        default 3
        ---help---
            Value limit in 1-100.
            The max running tasks in the same time.

    config TINATEST_SYS_GLOBAL_LIMIT_TINATEST_RUN_TIME
        string "tinatest_run_time"
        default "0 0 0 356"
        ---help---
            Time limit for tinatest to run.
            It is in format:
                <sec> <min> <hour> <day>
            For example,
            100s : 100
            1m20s : 20 1 (or 80)
            1d3h : 0 0 3 1 (or 0 0 28 or other)

endif
```

## package/testtools/tinatest/config/sys/local/Config.in
```kconfig
menuconfig TINATEST_SYS_LOCAL
    bool "local"
    default y

if TINATEST_SYS_LOCAL
    source info/Config.in
    source limit/Config.in
endif
```

## package/testtools/tinatest/config/sys/local/info/Config.in
```kconfig
config TINATEST_SYS_LOCAL_INFO
    bool 'info'
    default y

if TINATEST_SYS_LOCAL_INFO
    config TINATEST_SYS_LOCAL_INFO_DATE
        bool "date"
        default y
        ---help---
            Save Running Date.

    config TINATEST_SYS_LOCAL_INFO_RESOURCE
        bool "resource"
        default y
        ---help---
            Save resources for each testcase.

    config TINATEST_SYS_LOCAL_INFO_REAL_TIME_LOG
        bool "real_time_log"
        default n
        ---help---
            Print log of testcase real time.
            In default, tinatest just collect all log, and print them when testcase end.

endif
```

## package/testtools/tinatest/config/sys/local/limit/Config.in
```kconfig
config TINATEST_SYS_LOCAL_LIMIT
    bool 'limit'
    default y

if TINATEST_SYS_LOCAL_LIMIT
    config TINATEST_SYS_LOCAL_LIMIT_RUN_TIMES
        int "run_times"
        default 1
        ---help---
            The times to run testcase.
            For example:
            To run this testcase for 3 times, we can set this value as 3.

    config TINATEST_SYS_LOCAL_LIMIT_RUN_ALONE
        bool "run_alone"
        default n
        ---help---
            Wait for finishing all previous testcase and run alone before do next.

    config TINATEST_SYS_LOCAL_LIMIT_MAY_REBOOT
        bool "may_reboot"
        default n
        ---help---
            It means that device will be rebooted while running testcase.
            All states of testcase will be saved in flash, and loaded after rebooting.
            Notices that, if may_reboot is setted, run_alone will be setted alway.

    config TINATEST_SYS_LOCAL_LIMIT_RUN_PARALLEL
        bool "run_parallel"
        default n
        ---help---
            Run parallel for all run_times.
            For example:
            Testcae will run for 3 times one by one if run_times=3.
            However, if run_parallel is setted, tinatest will creates 3 processers in one time.

    config TINATEST_SYS_LOCAL_LIMIT_TESTCASE_RUN_ONCE_TIME
        string "testcase_run_once_time"
        default "0 0 0 356"
        ---help---
            Time limit for testcase to run once.
            It is in format:
                <sec> <min> <hour> <day>
            For example,
            100s : 100
            1m20s : 20 1 (or 80)
            1d3h : 0 0 3 1 (or 0 0 28 or other)

    config TINATEST_SYS_LOCAL_LIMIT_TESTCASE_RUN_TIME
        string "testcase_run_time"
        default "0 0 0 356"
        ---help---
            Time limit for testcase to run.
            It is in format:
                <sec> <min> <hour> <day>
            For example,
            100s : 100
            1m20s : 20 1 (or 80)
            1d3h : 0 0 3 1 (or 0 0 28 or other)

    config TINATEST_BASE_BLUETOOTH_TIMEOUT_AS_FAILED
        bool "timeout_as_failed"
        default n
        ---help---
            Seem to failed when testcase exit for timeout.
            If not set, default to pass.

    config TINATEST_SYS_LOCAL_LIMIT_EXIT_ONCE_FAILED
        bool "exit_once_failed"
        default n
        ---help---
            Stop running testcase and exit once failed, even if runned times less than run_times.

endif
```

## package/utils/busybox/Config.in
```kconfig
if PACKAGE_busybox


config BUSYBOX_CUSTOM
	bool "Customize busybox options"
	default n
        help
          Enabling this allows full customization of busybox settings.
          Note that there are many options here that can result in a build
          that doesn't work properly.  Enabling customization will mark your
          build as "tainted" for the purpose of bug reports.
          See the variables written to /etc/openwrt_release

          Unless you know what you are doing, you should leave this as 'n'

	if SYSTEM_INIT_PROCD
		if USE_SELINUX && PACKAGE_selinux
		source "Config-selinux-default.in"
		endif
	source "Config-defaults.in"
	endif

	if SYSTEM_INIT_BUSYBOX
		if USE_SELINUX && PACKAGE_selinux
		source "Config-busybox-selinux-default.in"
		endif
	source "Config-busybox-init-defaults.in"
	endif

	if BUSYBOX_CUSTOM
	source "config/Config.in"
	endif

config BUSYBOX_USE_LIBRPC
	bool
	default y if BUSYBOX_CUSTOM && BUSYBOX_CONFIG_FEATURE_HAVE_RPC
	default y if !BUSYBOX_CUSTOM && BUSYBOX_DEFAULT_FEATURE_HAVE_RPC

endif
```

## package/utils/mtools/Config.in
```kconfig
if PACKAGE_mtools

config MTOOLS_MATTRIB
	bool "Enable mattrib support"
	default y
	help
		This option will support mtool build with mattrib


config MTOOLS_MBADBLOCKS
	bool "Enable mbadblocks support"
	default y
	help
		This option will support mtool build with mbadblocks


config MTOOLS_MCAT
	bool "Enable mcat support"
	default y
	help
		This option will support mtool build with mcat


config MTOOLS_MCD
	bool "Enable mcd support"
	default y
	help
		This option will support mtool build with mcd


config MTOOLS_MCLASSERASE
	bool "Enable mclasserase support"
	default y
	help
		This option will support mtool build with mclasserase


config MTOOLS_MCOPY
	bool "Enable mcopy support"
	default y
	help
		This option will support mtool build with mcopy


config MTOOLS_MDEL
	bool "Enable mdel support"
	default y
	help
		This option will support mtool build with mdel


config MTOOLS_MDELTREE
	bool "Enable mdeltree support"
	default y
	help
		This option will support mtool build with mdeltree


config MTOOLS_MDIR
	bool "Enable mdir support"
	default y
	help
		This option will support mtool build with mdir


config MTOOLS_MDOCTORFAT
	bool "Enable mdoctorfat support"
	default y
	help
		This option will support mtool build with mdoctorfat


config MTOOLS_MDU
	bool "Enable mdu support"
	default y
	help
		This option will support mtool build with mdu


config MTOOLS_MFORMAT
	bool "Enable mformat support"
	default y
	help
		This option will support mtool build with mformat


config MTOOLS_MINFO
	bool "Enable minfo support"
	default y
	help
		This option will support mtool build with minfo


config MTOOLS_MLABEL
	bool "Enable mlabel support"
	default y
	help
		This option will support mtool build with mlabel


config MTOOLS_MMD
	bool "Enable mmd support"
	default y
	help
		This option will support mtool build with mmd


config MTOOLS_MMOUNT
	bool "Enable mmount support"
	default y
	help
		This option will support mtool build with mmount


config MTOOLS_MPARTITION
	bool "Enable mpartition support"
	default y
	help
		This option will support mtool build with mpartition


config MTOOLS_MRD
	bool "Enable mrd support"
	default y
	help
		This option will support mtool build with mrd


config MTOOLS_MREAD
	bool "Enable mread support"
	default y
	help
		This option will support mtool build with mread


config MTOOLS_MMOVE
	bool "Enable mmove support"
	default y
	help
		This option will support mtool build with mmove


config MTOOLS_MREN
	bool "Enable mren support"
	default y
	help
		This option will support mtool build with mren


config MTOOLS_MSHOWFAT
	bool "Enable mshowfat support"
	default y
	help
		This option will support mtool build with mshowfat


config MTOOLS_MSHORTNAME
	bool "Enable mshortname support"
	default y
	help
		This option will support mtool build with mshortname


config MTOOLS_MTOOLSTEST
	bool "Enable mtoolstest support"
	default y
	help
		This option will support mtool build with mtoolstest


config MTOOLS_MTYPE
	bool "Enable mtype support"
	default y
	help
		This option will support mtool build with mtype


config MTOOLS_MWRITE
	bool "Enable mwrite support"
	default y
	help
		This option will support mtool build with mwrite


config MTOOLS_MZIP
	bool "Enable mzip support"
	default y
	help
		This option will support mtool build with mzip
endif
```

## package/wayland/glmark2/Config.in
```kconfig
if PACKAGE_glmark2

config GLMARK2_FBDEV
    bool "Enabel fbdev support"
    default n

config GLMARK2_WAYLAND
    bool "Enabel wayland support"
    default y
endif
```

## package/wayland/weston/Config.in
```kconfig
if PACKAGE_weston

config WESTON_DBUS
    bool "Enabel dbus support"
    default n

config WESTON_LAUNCH
    bool "Enabel weston-launch linux pam support"
    default n

config WESTON_OPENGL_ES
    bool "Enabel opengl es support"
    default y

config WESTON_FBDEV
    bool "Enabel fbdev compositor support"
    default n

config WESTON_DRM
    bool "Enabel drm compositor support"
    default y

#config WESTON_LIBVA
#    bool "Enabel vaapi recorder support"
#    default n

config WESTON_LCMS2
    bool "Enabel lcms support"
    default n

#config WESTON_SYSTEMD
#    bool "Enabel systemd login and notify support"
#    default n

config WESTON_LIBXML2
    bool "Enabel junit xml support"
    default n

config WESTON_DEMO_CLIENTS
    bool "Enabel demo clients install"
    default n

endif
```

## target/allwinner/generic/image/Config.in
```kconfig
config SUNXI_SD_BOOT_PART
	bool "Build filesystem for Boot (SD Card) partition"
	default n

config SUNXI_SD_BOOT_PARTSIZE
	int "Boot (SD Card) filesystem partition size (in MB)"
	depends on SUNXI_SD_BOOT_PART
	default 4

choice
	prompt "Boot (SD Card) Kernel format"
	default uImage

	config SUNXI_SD_BOOT_KERNEL_FORMAT_UIMAGE
	bool "uImage"

	config SUNXI_SD_BOOT_KERNEL_FORMAT_BOOTIMG
	bool "boot.img"
endchoice

config SUNXI_MKBOOTIMG_ADD_DTB
	bool "mkbootimge add dtb to boot.img"
	depends on SUNXI_SD_BOOT_KERNEL_FORMAT_BOOTIMG
	default n

config SUNXI_SMALL_STORAGE_OTA
	bool "For storage less than 32M, enable this when using ota"
	default n

config SUNXI_RECOVERY_INITRAMFS_PART
	bool "Build filesystem for Boot-Recovery initramfs partition"
	default n

config SUNXI_RECOVERY_INITRAMFS_PARTSIZE
	int "Boot-Recovery initramfs filesystem partition size (in MB)"
	depends on SUNXI_RECOVERY_INITRAMFS_PART
	default 7


choice
	prompt "Boot-Recovery initramfs Kernel format"
	default uImage

	config SUNXI_RECOVERY_INITRAMFS_KERNEL_FORMAT_UIMAGE
	bool "uImage"

	config SUNXI_RECOVERY_INITRAMFS_KERNEL_FORMAT_BOOTIMG
	bool "boot.img"
endchoice

config SUNXI_SEPARATE_APP_FROM_ROOTFS
	bool "Separate /mnt/app from rootfs"
	default n

config SUNXI_SEPARATE_DATA_FROM_ROOTFS
	bool "Separate /data from rootfs"
	default n

menuconfig CUSTOMIZE_IMAGE_NAME
	bool "customize image name"
	default n
	help
	   Customize image name

	choice
		prompt "Boot Image(kernel) name suffix"
		default CONFIG_BOOT_IMAGE_NAME_SUFFIX_NONE
		depends on CUSTOMIZE_IMAGE_NAME
		help
		   Customize Boot image(kernel) name

		config SUNXI_BOOT_IMAGE_NAME_SUFFIX_NONE
		bool "boot.img/boot_initramfs.img"

		config SUNXI_BOOT_IMAGE_NAME_SUFFIX_RECOVERY
		bool "boot_recovery.img/boot_initramfs_recovery.img"

		config SUNXI_BOOT_IMAGE_NAME_SUFFIX_RAMFS
		bool "boot_ramfs.img/boot_initramfs_ramfs.img"
	endchoice

	choice
		prompt "Rootfs Image name suffix"
		default CONFIG_ROOTFS_IMAGE_NAME_SUFFIX_NONE
		depends on CUSTOMIZE_IMAGE_NAME
		help
		   Customize rootfs image name

		config SUNXI_ROOTFS_IMAGE_NAME_SUFFIX_NONE
		bool "rootfs.img"

		config SUNXI_ROOTFS_IMAGE_NAME_SUFFIX_RECOVERY
		bool "rootfs_recovery.img"

		config SUNXI_ROOTFS_IMAGE_NAME_SUFFIX_RAMFS
		bool "rootfs_ramfs.img"
	endchoice

menuconfig CUSTOMIZE_CONFIG_FILE
	bool "customize config file"
	default n
	help
	   Customize image config file

	choice
		prompt "Kernel config file suffix"
		default KERNEL_CONFIG_FILE_SUFFIX_NONE
		depends on CUSTOMIZE_CONFIG_FILE
		help
		  Customize kernel config file

		config KERNEL_CONFIG_FILE_SUFFIX_NONE
		bool "config-x.x"

		config KERNEL_CONFIG_FILE_SUFFIX_RECOVERY
		bool "config-x.x_recovery"

		config KERNEL_CONFIG_FILE_SUFFIX_RAMFS
		bool "config-x.x_ramfs"
	endchoice
```

## toolchain/binutils/Config.in
```kconfig
# Choose binutils version.

choice
	prompt "Binutils Version" if TOOLCHAINOPTS
	default BINUTILS_USE_VERSION_2_27 if !arc
	help
	  Select the version of binutils you wish to use.

	config BINUTILS_USE_VERSION_2_25
		depends on !arc
		bool "Binutils 2.25"
		select BINUTILS_VERSION_2_25

	config BINUTILS_USE_VERSION_2_26
		depends on !arc
		bool "Binutils 2.26"
		select BINUTILS_VERSION_2_26

	config BINUTILS_USE_VERSION_2_27
		depends on !arc
		bool "Binutils 2.27"
		select BINUTILS_VERSION_2_27

	config BINUTILS_USE_VERSION_2_28
		depends on !arc
		bool "Binutils 2.28"
		select BINUTILS_VERSION_2_28

endchoice

config EXTRA_BINUTILS_CONFIG_OPTIONS
	string
	prompt "Additional binutils configure options" if TOOLCHAINOPTS
	default ""
	help
	    Any additional binutils options you may want to include....
```
