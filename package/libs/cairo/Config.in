## package/libs/cairo/Config.in
```kconfig
if PACKAGE_libcairo

config CAIRO_PS
	bool
	default n
	prompt "Enable cairo postscript support"
	select PACKAGE_zlib
	select CAIRO_PDF

config CAIRO_PDF
	bool
	default y
	prompt "Enable cairo pdf support"

config CAIRO_PNG
	bool
	default y
	prompt "Enable cairo png support"

config CAIRO_SCRIPT
	bool
	default n
	prompt "Enable script support"

config CAIRO_SVG
	bool
	default n
	prompt "Enable cairo svg support"

config CAIRO_TEE
	bool
	default n
	prompt "Enable cairo tee support"

config CAIRO_XML
	bool
	default n
	prompt "Enable cairo xml support"

endif
```

## package/libs/cyassl/Config.in
```kconfig
if PACKAGE_libcyassl

config CYASSL_WITH_STATIC
	bool
	default n
	prompt "Build static libraries"
	help

config CYASSL_WITH_DEBUG
	bool
	default n
	prompt "Add debug code/turns off optimizations (yes|no)"
	help

config CYASSL_WITH_SSLV3
	bool
	default n
	prompt "Enable ssl version 3.0 "
	help

config CYASSL_WITH_AFALG
	bool
	default y
	prompt "Enable linux af_alg use for crypto "
	help

config CYASSL_WITH_ZERO_COPY
	bool
	default y
	depends on CYASSL_WITH_AFALG
	prompt "Support to use splice send data for afalg"
	help

config CYASSL_WITH_SINGLETHREADED
	bool
	default y
	prompt "Enable wolfssl single threaded"
	help

choice
      prompt "Openssl Compatible"
      default CYASSL_WITH_OPENSSLEXTRA
      depends on PACKAGE_libcyassl

config CYASSL_WITH_OPENSSLCOEXIST
	bool
	prompt "Enable coexistence of wolfssl/openssl"
	help


config CYASSL_WITH_OPENSSLALL
	bool
	prompt "Enable all openssl api, size++"
	help


config CYASSL_WITH_OPENSSLEXTRA
	bool
	select CYASSL_WITH_PWDBASED
	select CYASSL_WITH_CODING
	prompt "Enable extra openssl api, size+"
	help

endchoice

menu "Cipher Algorithms"
     depends on PACKAGE_libcyassl

config CYASSL_WITH_IDEA
	bool
	default n
	prompt "Enable idea cipher "
	help


config CYASSL_WITH_ARC4
	bool
	default n
	prompt "Enable arc4 support"
	help

config CYASSL_WITH_CMAC
	bool
	default n
	prompt "Enable cmac "
	help

config CYASSL_WITH_AES
	bool
	default y
	prompt "Enable aes algorithm support"
	help


config CYASSL_WITH_XTS
	bool
	depends on CYASSL_WITH_AES
	default n
	prompt "Enable wolfssl aes-xts support"
	help


config CYASSL_WITH_AESCBC
	bool
	depends on CYASSL_WITH_AES
	default y
	prompt "Enable wolfssl aes-cbc support "
	help


config CYASSL_WITH_AESGCM
	bool
	depends on CYASSL_WITH_AES
	default n
	prompt "Enable wolfSSL AES-GCM support"
	help

config CYASSL_WITH_AESCTR
	bool
	depends on CYASSL_WITH_AES
	default n
	prompt "Enable wolfssl aes-ctr support "
	help


config CYASSL_WITH_AESCFB
	bool
	depends on CYASSL_WITH_AES
	default n
	prompt "Enable wolfssl aes-cfb support "
	help

config CYASSL_WITH_AESKEYWRAP
	bool
	depends on CYASSL_WITH_AES
	default n
	prompt "Enable aes key wrap support "
	help

endmenu

menu "Hash Algorithms"
       depends on PACKAGE_libcyassl


config CYASSL_WITH_HASHDRBG
	bool
	default y
	prompt "Enable hash drbg support "
	help


config CYASSL_WITH_SHA
	bool
	default y
	prompt "Enable wolfssl sha support"
	help


config CYASSL_WITH_SHA3
	bool
	default y
	prompt "Enable wolfssl sha-3 support"
	help


config CYASSL_WITH_SHA224
	bool
	default y
	depends on !CYASSL_WITH_AFALG
	prompt "Enable wolfssl sha-224 support"
	help

config CYASSL_WITH_SHA384
	bool
	default y
	prompt "Enable wolfssl sha-384 support"
	help

config CYASSL_WITH_SHA512
	bool
	default y
	prompt "Enable wolfssl sha-512 support"
	help


config CYASSL_WITH_MD2
	bool
	default n
	prompt "Enable wolfssl md2 support"
	help


config CYASSL_WITH_MD4
	bool
	default n
	prompt "Enable wolfssl md4 support"
	help


config CYASSL_WITH_MD5
	bool
	default y
	prompt "Enable wolfssl md5 support"
	help

endmenu


menu "RSA Algorithms"
	depends on CYASSL_WITH_ASN

config CYASSL_WITH_DH
	bool
	default y
	prompt "Enable dh support"
	help


config CYASSL_WITH_RSA
	bool
	default y
	prompt "Enable rsa support"
	help


config CYASSL_WITH_OAEP
	bool
	default y
	prompt "Enable rsa-oaep support"
	help


config CYASSL_WITH_RSAPUB
	bool
	default n
	prompt "Enable rsa public only "
	help


config CYASSL_WITH_RSAVFY
	bool
	default n
	prompt "Enable rsa verify inline only "
	help


config CYASSL_WITH_RSAPSS
	bool
	default n
	prompt "Enable rsa-pss "
	help

endmenu

menu "PKCSx Type"

config CYASSL_WITH_PKCS7
	bool
	default n
	prompt "Enable pkcs7  access"
	help


config CYASSL_WITH_PKCS11
	bool
	default n
	prompt "Enable pkcs11 access"
	help


config CYASSL_WITH_PKCS12
	bool
	default y
	prompt "Enable pkcs12 access"
	help

endmenu

menu "TLS Type"

config CYASSL_WITH_OLDTLS
	bool
	default n
	prompt "Enable old TLS versions < 1.2"
	help

config CYASSL_WITH_TLSV10
	bool
	depends on CYASSL_WITH_OLDTLS
	default n
	prompt "Enable old TLS versions 1.0"
	help

config CYASSL_WITH_TLS13
	bool
	default n
	prompt "Enable wolfSSL TLS v1.3"
	help

config CYASSL_WITH_TLS13_DRAFT18
	bool
	depends on CYASSL_WITH_TLS13
	default n
	prompt "Enable wolfSSL TLS v1.3 Draft 18"
	help

config CYASSL_WITH_TLS13_DRAFT22
	bool
	depends on CYASSL_WITH_TLS13
	default n
	prompt "Enable wolfSSL TLS v1.3 Draft 22"
	help

config CYASSL_WITH_TLS13_DRAFT23
	bool
	depends on CYASSL_WITH_TLS13
	default n
	prompt "Enable wolfSSL TLS v1.3 Draft 23"
	help

config CYASSL_WITH_TLS13_DRAFT26
	bool
	depends on CYASSL_WITH_TLS13
	default n
	prompt "Enable wolfSSL TLS v1.3 Draft 26"
	help

config CYASSL_WITH_TLS13_DRAFT28
	bool
	depends on CYASSL_WITH_TLS13
	default n
	prompt "Enable wolfSSL TLS v1.3 Draft 28"
	help

endmenu


config CYASSL_WITH_FILESYSTEM
	bool
	default n
	prompt "Enable Filesystem support"
	help
	   This option can read pem/x509/der format key from file,
	   it you do not need it, select n.

config CYASSL_WITH_POLY1305
	bool
	default n
	prompt "Enable wolfSSL POLY1305 support"
	help

config CYASSL_WITH_CHACHA
	bool
	default n
	prompt "Enable CHACHA support"
	help

config CYASSL_WITH_ASN
	bool
	default y
	prompt "Enable asn support"
	help

config CYASSL_WITH_ECC
	bool
	depends on CYASSL_WITH_ASN
	default y
	prompt "Enable ecc support"
	help


config CYASSL_WITH_ECCSHAMIR
	bool
	depends on CYASSL_WITH_ECC
	default y
	prompt "Enable ecc shamir "
	help

endif
```

## package/libs/efl/efl/Config.in
```kconfig
if PACKAGE_efl

config EFL_BUILD_HOST
    bool "Whether to build hosting tools"
    default y
    help
	Because compiling EFL requires compiling the host tools first.
	If compilation error, suggesting can not execute binary file:Exec format error,
	you need to select this option.

config EFL_FB
    bool "Enable raw Framebuffer access"
    default n

config EFL_WAYLAND
    bool "Enabel wayland display server"
    default y

#config EFL_DRM
#    bool "Enable drm engine"
#    default n

config EFL_OPENGLES
    bool "Enabel opengl es support"
    default n

config EFL_PIXMAN
    bool "Enable pixman for software rendering"
    default n

config EFL_FONT_CONFIG
    bool "Enable fontconfig for finding fonts"
    default y

config EFL_FRIBIDI
    bool "Enable bidirectional text support"
    default n

#config EFL_GSTREAMER1
#    bool "Enable gstreamer 1.0 support"
#    default n

config EFL_TSLIB
    bool "Enable tslib for touchscreen events"
    default n

config EFL_GLIB
    bool "Enabel glib2 support"
    default n

config EFL_AUDIO
    bool "Enable audio support"
    default n

endif
```

## package/libs/libdrm/Config.in
```kconfig
if PACKAGE_libdrm

config LIBDRM_TEST_PROGRAMS
    bool "install libdrm test programs"
    default n

config LIBDRM_V4C
    bool "Enable support for vc4's API"
    default n

endif
```

## package/libs/libgtk3/Config.in
```kconfig
config LIBGTK3
	bool "libgtk3"
	select PACKAGE_atk
	select PACKAGE_cairo
	select CONFIG_CAIRO_PS
	select CONFIG_CAIRO_PDF
	select CONFIG_CAIRO_SVG
	select CONFIG_LIBEPOXY
	select PACKAGE_libglib2
	select PACKAGE_pango
	select PACKAGE_gdk_pixbuf
	# At least one backend is required
	select CONFIG_LIBGTK3_BROADWAY if \
		!(CONFIG_LIBGTK3_X11 || CONFIG_LIBGTK3_WAYLAND)
	depends on USE_WCHAR # glib2
	depends on TOOLCHAIN_HAS_THREADS # glib2
	depends on USE_MMU # glib2
	depends on INSTALL_LIBSTDCPP # pango
	depends on TOOLCHAIN_HAS_SYNC_4 # pango -> harfbuzz
	depends on HAS_LIBEGL_WAYLAND || \
		PACKAGE_HAS_LIBGL
	help
	  The GTK+ version 3 graphical user interface library

	  http://www.gtk.org/

if PACKAGE_libgtk3

config LIBGTK3_BROADWAY
	bool "Broadway GDK backend"
	default y
	  help
	  This enables the Broadway backend for GDK, which provides support
	  for displaying GTK+ applications in a web browser, using HTML5 and
	  web sockets.

	  For example, to run gtk3-demo on a target which IP address is
	  192.168.0.1 and use it from a web browser, execute the following
	  commands:

	  $ broadwayd -a 192.168.0.1 -p 8080 :2 &
	  $ export GDK_BACKEND=broadway
	  $ export BROADWAY_DISPLAY=:2
	  $ gtk3-demo

	  Then open a web browser at address http://192.168.0.1:8080.
	  Javascript and web sockets should be enabled.

comment "Wayland GDK backend needs an OpenGL EGL backend provided by mesa3d w/ headers >= 3.17"

config LIBGTK3_WAYLAND
	bool "Wayland GDK backend"
	default y
	select PACKAGE_wayland
	select PACKAGE_wayland_protocols
	select PACKAGE_libxkbcommon
	help
	  This enables the Wayland backend for GDK.

comment "X11 GDK backend needs an OpenGL provider"
	depends on !PACKAGE_HAS_LIBGL

config LIBGTK3_X11
	bool "X11 GDK backend"
	default y
	depends on BR2_PACKAGE_XORG7
	depends on BR2_PACKAGE_HAS_LIBGL
	select PACKAGE_fontconfig
	select PACKAGE_xlib_libx11
	select PACKAGE_xlib_libxext
	select PACKAGE_xlib_libxrender
	select PACKAGE_xlib_libxi
	help
	  This enables the X11 backend for GDK.

config LIBGTK3_DEMO
	bool "Install libgtk3 demo program"
	select PACKAGE_SHARED_MIME_INFO
	select PACKAGE_HICOLOR_ICON_THEME
	help
	  The GTK+ source base contains a demo program. This
	  option allows to install this program to the target.

config LIBGTK3_TESTS
	bool "Install libgtk3 tests"
	help
	  The GTK+ source base contains tests. This option
	  allows to install them to the target.

endif
```

## package/libs/libwebp/Config.in
```kconfig
if PACKAGE_webp

config WEBP_DEMUX
	bool "webpdemux"
	help
	  Demux is a part of WebPMux for extraction and manipulation
	  of an extended format WebP file, which can have features
	  like color profile, metadata and animation.

endif
```

## package/libs/webkitgtk/Config.in
```kconfig
if PACKAGE_webkitgtk

config WEBKITGTK_HTTPS
	bool "HTTPS support"
	select PACKAGE_ca_certificates
	select PACKAGE_libsoup_ssl
	help
	  Enable HTTPS protocol support.

config WEBKITGTK_MULTIMEDIA
	bool "multimedia support"
	select PACKAGE_gstreamer1
	select PACKAGE_gst1_plugins_base
	select PACKAGE_gst1_plugins_base_plugin_alsa
	select PACKAGE_gst1_plugins_base_plugin_app
	select PACKAGE_gst1_plugins_base_plugin_audioconvert
	select PACKAGE_gst1_plugins_base_plugin_audioresample
	select PACKAGE_gst1_plugins_base_plugin_playback
	select PACKAGE_gst1_plugins_base_plugin_videoconvert
	select PACKAGE_gst1_pugins_base_plugin_videoscale
	select PACKAGE_gst1_plugins_base_plugin_volume
	select PACKAGE_gst1_plugins_good
	select PACKAGE_gst1_plugins_good_plugin_isomp4
	select PACKAGE_gst1_plugins_good_plugin_rtsp
	select PACKAGE_gst1_libav
	help
	  This option pulls in all of the required dependencies
	  to enable multimedia (video/audio) support.
endif
```

## package/minigui/libminigui-gpl/Config.in
```kconfig
if PACKAGE_libminigui-gpl
choice
prompt "Preferred Minigui Run Mode"
	default MINIGUI_THS
	help
	Select the preferred minigui running mode.
config MINIGUI_THS
	bool "ths"
config MINIGUI_PROC
	bool "proc"
endchoice
config TTF2_SUPPORT
    bool "Enabel truetype font support"
    default y
        help
          Enabling True type font support for minigui.
          You need config the font path in MiniGUI.cfg.
          And add font in res path.
          Unless you know what you are doing, you should leave this as 'n'
config TSLIB_SUPPORT
    bool "Enabel tslib support for MiniGUI"
    default n
        help
          Enabling tslib ial support for minigui.
          You need config ialengine in MiniGUI.cfg.
          And add pointercal in /etc directory.
		  Unless you know what you are doing, you should leave this as 'n'
config G2D_SUPPORT
    bool "Enabel g2d support for MiniGUI"
    default n
        help
        Enabling g2d support for minigui
config SUNXIFB_SUPPORT
    bool "Enabel sunxifb support for MiniGUI"
    default n
        help
        Enabling sunxifb support for minigui
config SUNXIFBION_SUPPORT
    bool "Enabel sunxifbion support for MiniGUI"
    default n
        help
        Enabling sunxifbion support for minigui
config CCW_SUPPORT
    bool "Enabel coortrans cw support for MiniGUI"
    default n
        help
          Enabling rotate support for minigui.
          You need config system in MiniGUI.cfg.
          And adjust the width and height.
		  Unless you know what you are doing, you should leave this as 'n'
config BUILD_LIB_MIN
    bool "Enabel reduce size for MiniGUI"
    default n
        help
          Reduce the unwanted function module of minigui.
          You need config system in MiniGUI.cfg.
          Adust the font config and reduce cursor resource.
		  Unless you know what you are doing, you should leave this as 'n'
endif
```

## package/multimedia/pulseaudio/Config.in
```kconfig
if PACKAGE_pulseaudio-daemon

config PULSEAUDIO_DAEMON_ENABLE_UDEV
    bool "Enable UDEV support"
    default n
    select PACKAGE_eudev

config PULSEAUDIO_DAEMON_ENABLE_DBUS
    bool "Enable D-Bus support"
    default n
    select PACKAGE_dbus

endif
```

## package/security/cryptsetup/Config.in
```kconfig
if PACKAGE_cryptsetup

choice

prompt "use crypt lib"
default CRYPTSETUP_OPENSSL
help
  "select the crypt libs for cryptsetup"

config CRYPTSETUP_GCRYPT
	bool "use libgcrypt"

config CRYPTSETUP_OPENSSL
	bool "use libopenssl"

endchoice

endif
```

## package/security/optee-os-dev-kit/Config.in
```kconfig
if PACKAGE_optee-os-dev-kit

config OPTEE_ENCRYPT_TA
        bool "whether encrypt ta"
        depends on PLATFORM_r328s2 || PLATFORM_r328s3
        default n

choice
	prompt "encrypt ta with which key"
	default OPTEE_ENCRYPT_TA_SSK_KEY
	depends on OPTEE_ENCRYPT_TA
	help
	  Select the block size of the root filesystem.

	config OPTEE_ENCRYPT_TA_SSK_KEY
	        bool "ssk"

	config OPTEE_ENCRYPT_TA_RTOPK_DERIVE_KEY
	        bool "key derive from rotpk"
endchoice

endif
```

## package/testtools/tinatest/config/Config.in
```kconfig
if PACKAGE_tinatest
    comment "Settings For TINATEST"
    source sys/Config.in

    comment "Settings For TESTCASES"
    source demo/Config.in
    source base/Config.in
    source spec/Config.in
    source stress/Config.in
endif
```

## package/testtools/tinatest/config/base/Config.in
```kconfig
menuconfig TINATEST_BASE
    bool "base"
    default y

if TINATEST_BASE
    source production/Config.in
    source storage/Config.in
    source audio/Config.in
    source display/Config.in
    source wifi/Config.in
endif
```

## package/testtools/tinatest/config/base/audio/Config.in
```kconfig
menuconfig TINATEST_BASE_AUDIO
    bool "audio"

if TINATEST_BASE_AUDIO
    source common/Config.in
    source headphone_playback/Config.in
    source speaker_playback/Config.in
    source mic_capture/Config.in
endif
```

## package/testtools/tinatest/config/base/audio/common/Config.in
```kconfig
menuconfig TINATEST_BASE_AUDIO_COMMON
    bool "common"

if TINATEST_BASE_AUDIO_COMMON
    source captureloop/Config.in
    source playbackloop/Config.in
endif
```
