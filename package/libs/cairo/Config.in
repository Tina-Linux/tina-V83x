## package/testtools/tinatest/config/base/audio/common/playbackloop/Config.in
```kconfig
menuconfig TINATEST_BASE_AUDIO_COMMON_PLAYBACKLOOP_ENABLE
    bool "playbackloop"
    default n
    select PACKAGE_alsa-ucm-aw-utils
    select PACKAGE_alsa-utils
    ---help---
        Settings for /base/audio/common/playbackloop
        It safe to leave a blank for any settings.
        If not setted, TinaTest will use global settings or default settings instead.

if TINATEST_BASE_AUDIO_COMMON_PLAYBACKLOOP_ENABLE
    config TINATEST_BASE_AUDIO_COMMON_PLAYBACKLOOP_COMMAND
        default "playbackloop.sh"
    config TINATEST_BASE_AUDIO_COMMON_PLAYBACKLOOP_STDIN
        default ""
    config TINATEST_BASE_AUDIO_COMMON_PLAYBACKLOOP_FSTDIN
        default ""
    config TINATEST_BASE_AUDIO_COMMON_PLAYBACKLOOP_DATE
        default y if TINATEST_SYS_LOCAL_INFO_DATE
    config TINATEST_BASE_AUDIO_COMMON_PLAYBACKLOOP_RESOURCE
        default y if TINATEST_SYS_LOCAL_INFO_RESOURCE
    config TINATEST_BASE_AUDIO_COMMON_PLAYBACKLOOP_REAL_TIME_LOG
        default y if TINATEST_SYS_LOCAL_INFO_REAL_TIME_LOG
    config TINATEST_BASE_AUDIO_COMMON_PLAYBACKLOOP_RUN_TIMES
        default 1
    config TINATEST_BASE_AUDIO_COMMON_PLAYBACKLOOP_RUN_ALONE
        default y
    config TINATEST_BASE_AUDIO_COMMON_PLAYBACKLOOP_RUN_PARALLEL
        default n
    config TINATEST_BASE_AUDIO_COMMON_PLAYBACKLOOP_MAY_REBOOT
        default y if TINATEST_SYS_LOCAL_LIMIT_MAY_REBOOT
    config TINATEST_BASE_AUDIO_COMMON_PLAYBACKLOOP_TESTCASE_RUN_ONCE_TIME
        default ""
    config TINATEST_BASE_AUDIO_COMMON_PLAYBACKLOOP_TESTCASE_RUN_TIME
        default ""
    config TINATEST_BASE_AUDIO_COMMON_PLAYBACKLOOP_TIMEOUT_AS_FAILED
        default n
    config TINATEST_BASE_AUDIO_COMMON_PLAYBACKLOOP_EXIT_ONCE_FAILED
        default n

    config TINATEST_BASE_AUDIO_COMMON_PLAYBACKLOOP_VOLUME
        int "volume"
        default 50

    config TINATEST_BASE_AUDIO_COMMON_PLAYBACKLOOP_WAV_DIR
        string "wav_dir"
        default "/tmp/test_wav"

    config TINATEST_BASE_AUDIO_COMMON_PLAYBACKLOOP_CARD
        string "card"
        default "audiocodec"

    config TINATEST_BASE_AUDIO_COMMON_PLAYBACKLOOP_SAMPLE_RATE
        string "sample_rate"
        default "16000 48000"

    config TINATEST_BASE_AUDIO_COMMON_PLAYBACKLOOP_SAMPLE_BITS
        string "sample_bits"
        default "S16_LE"

    config TINATEST_BASE_AUDIO_COMMON_PLAYBACKLOOP_CHANNELS
        string "channels"
        default "2"

    config TINATEST_BASE_AUDIO_COMMON_PLAYBACKLOOP_MUSIC_SEC
        int "music_sec"
        default 10

    config TINATEST_BASE_AUDIO_COMMON_PLAYBACKLOOP_FUNCTION
        int "function"
        default 0

    config TINATEST_BASE_AUDIO_COMMON_PLAYBACKLOOP_EXTERNAL_DEVICE
        string "external_device"
        default "Speaker"

    comment "Advanced Customized"
    config TINATEST_BASE_AUDIO_COMMON_PLAYBACKLOOP_ADVANCED
        bool "Advanced"

    if TINATEST_BASE_AUDIO_COMMON_PLAYBACKLOOP_ADVANCED
        config TINATEST_BASE_AUDIO_COMMON_PLAYBACKLOOP_COMMAND
            string "command"
            ---help---
                TinaTest will run this command to start testcase.
                It is the same as shell command which followed by argumemts.
                This setting is a mark of any testcase.

        config TINATEST_BASE_AUDIO_COMMON_PLAYBACKLOOP_STDIN
            string "stdin"
            ---help---
                Redirect a string array, which is setted in this configure, to standard input.
                For example,
                "one two three four" is equivalent to enter 4 times to testcase every run_time.
                The first time, enter "one" with new line,
                the second time, enter "two" with new line, and so on.

        config TINATEST_BASE_AUDIO_COMMON_PLAYBACKLOOP_FSTDIN
            string "fstdin"
            ---help---
                Redirect a file, which is setted in this configure, to standard input.

        config TINATEST_BASE_AUDIO_COMMON_PLAYBACKLOOP_INFO
            bool "INFO"
            default y

        if TINATEST_BASE_AUDIO_COMMON_PLAYBACKLOOP_INFO
            config TINATEST_BASE_AUDIO_COMMON_PLAYBACKLOOP_DATE
                bool "date"
                ---help---
                    Save running date and time.

            config TINATEST_BASE_AUDIO_COMMON_PLAYBACKLOOP_RESOURCE
                bool "resource"
                ---help---
                    Save resources for each testcase.

            config TINATEST_BASE_AUDIO_COMMON_PLAYBACKLOOP_REAL_TIME_LOG
                bool "real_time_log"
                ---help---
                    Print log of testcase real time.
                    In default, tinatest just collect all log, and print them when testcase end.
        endif

        config TINATEST_BASE_AUDIO_COMMON_PLAYBACKLOOP_LIMIT
            bool "LIMIT"
            default y

        if TINATEST_BASE_AUDIO_COMMON_PLAYBACKLOOP_LIMIT
            config TINATEST_BASE_AUDIO_COMMON_PLAYBACKLOOP_RUN_TIMES
                int "run_times"
                ---help---
                    The times to run testcase.
                    For example:
                    To run this testcase for 3 times, we can set this value as 3.

            config TINATEST_BASE_AUDIO_COMMON_PLAYBACKLOOP_RUN_ALONE
                bool "run_alone"
                ---help---
                    Wait for finishing all previous testcase and run alone before do next.

            config TINATEST_BASE_AUDIO_COMMON_PLAYBACKLOOP_RUN_PARALLEL
                bool "run_parallel"
                ---help---
                    Run parallel for all run_times.
                    For example:
                    Testcae will run for 3 times one by one if run_times=3.
                    However, if run_parallel is setted, tinatest will creates 3 processers
                    in one time.

            config TINATEST_BASE_AUDIO_COMMON_PLAYBACKLOOP_MAY_REBOOT
                bool "may_reboot"
                ---help---
                    It means that device will be rebooted while running testcase.
                    All states of testcase will be saved in flash, and loaded after rebooting.
                    Notices that, if may_reboot is setted, run_alone will be setted alway.

            config TINATEST_BASE_AUDIO_COMMON_PLAYBACKLOOP_TESTCASE_RUN_ONCE_TIME
                string "testcase_run_once_time"
                ---help---
                    Time limit for testcase to run once.
                    It is in format:
                        <sec> <min> <hour> <day>
                    For example,
                    100s : 100
                    1m20s : 20 1 (or 80)
                    1d3h : 0 0 3 1 (or 0 0 28 or other)

            config TINATEST_BASE_AUDIO_COMMON_PLAYBACKLOOP_TESTCASE_RUN_TIME
                string "testcase_run_time"
                ---help---
                    Time limit for testcase to run.
                    It is in format:
                        <sec> <min> <hour> <day>
                    For example,
                    100s : 100
                    1m20s : 20 1 (or 80)
                    1d3h : 0 0 3 1 (or 0 0 28 or other)

            config TINATEST_BASE_AUDIO_COMMON_PLAYBACKLOOP_TIMEOUT_AS_FAILED
                bool "timeout_as_failed"
                ---help---
                    Seem to failed when testcase exit for timeout.
                    If not set, default as pass.

            config TINATEST_BASE_AUDIO_COMMON_PLAYBACKLOOP_EXIT_ONCE_FAILED
                bool "exit_once_failed"
                ---help---
                    Stop running testcase and exit once failed,
                    even if runned times less than run_times.
        endif
    endif
endif
```

## package/testtools/tinatest/config/base/audio/speaker_playback/Config.in
```kconfig
menuconfig TINATEST_BASE_AUDIO_SPEAKER_PLAYBACK_ENABLE
    bool "speaker_playback"
    default n
    select PACKAGE_alsa-conf-aw
    select PACKAGE_alsa-utils
    ---help---
        Settings for /base/audio/speaker_playback
        It safe to leave a blank for any settings.
        If not setted, TinaTest will use global settings or default settings instead.

if TINATEST_BASE_AUDIO_SPEAKER_PLAYBACK_ENABLE
    config TINATEST_BASE_AUDIO_SPEAKER_PLAYBACK_COMMAND
        default "speaker_playback.sh"
    config TINATEST_BASE_AUDIO_SPEAKER_PLAYBACK_STDIN
        default ""
    config TINATEST_BASE_AUDIO_SPEAKER_PLAYBACK_FSTDIN
        default ""
    config TINATEST_BASE_AUDIO_SPEAKER_PLAYBACK_DATE
        default y if TINATEST_SYS_LOCAL_INFO_DATE
    config TINATEST_BASE_AUDIO_SPEAKER_PLAYBACK_RESOURCE
        default y if TINATEST_SYS_LOCAL_INFO_RESOURCE
    config TINATEST_BASE_AUDIO_SPEAKER_PLAYBACK_REAL_TIME_LOG
        default y if TINATEST_SYS_LOCAL_INFO_REAL_TIME_LOG
    config TINATEST_BASE_AUDIO_SPEAKER_PLAYBACK_RUN_TIMES
        default 1
    config TINATEST_BASE_AUDIO_SPEAKER_PLAYBACK_RUN_ALONE
        default y
    config TINATEST_BASE_AUDIO_SPEAKER_PLAYBACK_RUN_PARALLEL
        default n
    config TINATEST_BASE_AUDIO_SPEAKER_PLAYBACK_MAY_REBOOT
        default y if TINATEST_SYS_LOCAL_LIMIT_MAY_REBOOT
    config TINATEST_BASE_AUDIO_SPEAKER_PLAYBACK_TESTCASE_RUN_ONCE_TIME
        default ""
    config TINATEST_BASE_AUDIO_SPEAKER_PLAYBACK_TESTCASE_RUN_TIME
        default ""
    config TINATEST_BASE_AUDIO_SPEAKER_PLAYBACK_TIMEOUT_AS_FAILED
        default n
    config TINATEST_BASE_AUDIO_SPEAKER_PLAYBACK_EXIT_ONCE_FAILED
        default n

    config TINATEST_BASE_AUDIO_SPEAKER_PLAYBACK_PCM_DEVICE
        string "pcm_device"
        default "PlaybackSpeaker"

    config TINATEST_BASE_AUDIO_SPEAKER_PLAYBACK_WAV_FILE
        string "wav_file"
        default "/usr/lib/tt-data/48000-stereo-s16_le-5s.wav"

    comment "Advanced Customized"
    config TINATEST_BASE_AUDIO_SPEAKER_PLAYBACK_ADVANCED
        bool "Advanced"

    if TINATEST_BASE_AUDIO_SPEAKER_PLAYBACK_ADVANCED
        config TINATEST_BASE_AUDIO_SPEAKER_PLAYBACK_COMMAND
            string "command"
            ---help---
                TinaTest will run this command to start testcase.
                It is the same as shell command which followed by argumemts.
                This setting is a mark of any testcase.

        config TINATEST_BASE_AUDIO_SPEAKER_PLAYBACK_STDIN
            string "stdin"
            ---help---
                Redirect a string array, which is setted in this configure, to standard input.
                For example,
                "one two three four" is equivalent to enter 4 times to testcase every run_time.
                The first time, enter "one" with new line,
                the second time, enter "two" with new line, and so on.

        config TINATEST_BASE_AUDIO_SPEAKER_PLAYBACK_FSTDIN
            string "fstdin"
            ---help---
                Redirect a file, which is setted in this configure, to standard input.

        config TINATEST_BASE_AUDIO_SPEAKER_PLAYBACK_INFO
            bool "INFO"
            default y

        if TINATEST_BASE_AUDIO_SPEAKER_PLAYBACK_INFO
            config TINATEST_BASE_AUDIO_SPEAKER_PLAYBACK_DATE
                bool "date"
                ---help---
                    Save running date and time.

            config TINATEST_BASE_AUDIO_SPEAKER_PLAYBACK_RESOURCE
                bool "resource"
                ---help---
                    Save resources for each testcase.

            config TINATEST_BASE_AUDIO_SPEAKER_PLAYBACK_REAL_TIME_LOG
                bool "real_time_log"
                ---help---
                    Print log of testcase real time.
                    In default, tinatest just collect all log, and print them when testcase end.
        endif

        config TINATEST_BASE_AUDIO_SPEAKER_PLAYBACK_LIMIT
            bool "LIMIT"
            default y

        if TINATEST_BASE_AUDIO_SPEAKER_PLAYBACK_LIMIT
            config TINATEST_BASE_AUDIO_SPEAKER_PLAYBACK_RUN_TIMES
                int "run_times"
                ---help---
                    The times to run testcase.
                    For example:
                    To run this testcase for 3 times, we can set this value as 3.

            config TINATEST_BASE_AUDIO_SPEAKER_PLAYBACK_RUN_ALONE
                bool "run_alone"
                ---help---
                    Wait for finishing all previous testcase and run alone before do next.

            config TINATEST_BASE_AUDIO_SPEAKER_PLAYBACK_RUN_PARALLEL
                bool "run_parallel"
                ---help---
                    Run parallel for all run_times.
                    For example:
                    Testcae will run for 3 times one by one if run_times=3.
                    However, if run_parallel is setted, tinatest will creates 3 processers
                    in one time.

            config TINATEST_BASE_AUDIO_SPEAKER_PLAYBACK_MAY_REBOOT
                bool "may_reboot"
                ---help---
                    It means that device will be rebooted while running testcase.
                    All states of testcase will be saved in flash, and loaded after rebooting.
                    Notices that, if may_reboot is setted, run_alone will be setted alway.

            config TINATEST_BASE_AUDIO_SPEAKER_PLAYBACK_TESTCASE_RUN_ONCE_TIME
                string "testcase_run_once_time"
                ---help---
                    Time limit for testcase to run once.
                    It is in format:
                        <sec> <min> <hour> <day>
                    For example,
                    100s : 100
                    1m20s : 20 1 (or 80)
                    1d3h : 0 0 3 1 (or 0 0 28 or other)

            config TINATEST_BASE_AUDIO_SPEAKER_PLAYBACK_TESTCASE_RUN_TIME
                string "testcase_run_time"
                ---help---
                    Time limit for testcase to run.
                    It is in format:
                        <sec> <min> <hour> <day>
                    For example,
                    100s : 100
                    1m20s : 20 1 (or 80)
                    1d3h : 0 0 3 1 (or 0 0 28 or other)

            config TINATEST_BASE_AUDIO_SPEAKER_PLAYBACK_TIMEOUT_AS_FAILED
                bool "timeout_as_failed"
                ---help---
                    Seem to failed when testcase exit for timeout.
                    If not set, default as pass.

            config TINATEST_BASE_AUDIO_SPEAKER_PLAYBACK_EXIT_ONCE_FAILED
                bool "exit_once_failed"
                ---help---
                    Stop running testcase and exit once failed,
                    even if runned times less than run_times.
        endif
    endif
endif
```

## package/testtools/tinatest/config/base/display/Config.in
```kconfig
menuconfig TINATEST_BASE_DISPLAY
    bool "display"

if TINATEST_BASE_DISPLAY
    source displyiftester/Config.in
    source capturetester/Config.in
    source fbshottester/Config.in
endif
```

## package/testtools/tinatest/config/base/production/Config.in
```kconfig
menuconfig TINATEST_BASE_PRODUCTION
    bool "production"
    default y

if TINATEST_BASE_PRODUCTION
    source otgtester/Config.in
    source hosttester/Config.in
    source ethtester/Config.in
    source mictester/Config.in
    source sdcardtester/Config.in
    source nandtester/Config.in
    source tptester/Config.in
    source pmutester/Config.in
    source udisktester/Config.in
    source keytester/Config.in
    source rtctester/Config.in
    source emmctester/Config.in
    source excodectester/Config.in
    source headphonetester/Config.in
    source satatester/Config.in
    source batterytester/Config.in
    source lineintester/Config.in
    source ledarraytester/Config.in
    source displaytester/Config.in
    source ledstester/Config.in
    source cameratester/Config.in
    source testtrecorder/Config.in
endif
```
